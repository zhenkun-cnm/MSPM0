/**
 * @file    port_tft.c
 * @brief   Port 层 ST7735 TFT 彩屏驱动实现
 * @note    实现 dev_tft.h 的 DevTFT OOP 契约
 *          使用 SPI1 硬件外设（与 W25Q128 共用 PA17=SCK, PA18=MOSI）
 *          SPI_SCL(PB9) / SPI_SDA(PB8) / RES(PB10) / DC(PB11) / CS(PB14) / BLK(PB26) 使用 GPIO 控制
 *
 *          引脚电平初始态（用户默认全低）需在初始化时纠正为工作电平：
 *          - RESET: 低有效 → 初始拉低→延时→拉高完成硬件复位
 *          - CS:    低有效 → 空闲时拉高（不选中）
 *          - DC:    低=命令 / 高=数据 → 初始低（命令模式）
 *          - BLK:   高=背光使能 → 初始设为高（点亮背光）
 */

#include "port_tft.h"
#include "port_log.h"
#include "ti_msp_dl_config.h"
#include <ti/devices/msp/msp.h>
#include <ti/driverlib/driverlib.h>
#include <stdarg.h>
#include <stdio.h>

/* ================================================================
 *  SPI 超时计数器（与 port_flash.c 保持一致）
 * ================================================================ */
#define SPI_TIMEOUT_CNT     50000U

/* Device 层接口实例 */
static DevTFT s_tftIf;

/* ================================================================
 *  GPIO 控制宏（复用 ti_msp_dl_config.h 中的定义）
 *  已定义：LCD_PORT, LCD_LCD_RES_PIN, LCD_LCD_DC_PIN,
 *           LCD_LCD_CS_PIN, LCD_LCD_BLK_PIN
 *  以及对应的 IOMUX 定义
 * ================================================================ */
#define TFT_PORT            LCD_PORT
#define TFT_CS_PIN          LCD_LCD_CS_PIN
#define TFT_DC_PIN          LCD_LCD_DC_PIN
#define TFT_RES_PIN         LCD_LCD_RES_PIN
#define TFT_BLK_PIN         LCD_LCD_BLK_PIN

#define TFT_CS_LOW()        DL_GPIO_clearPins(TFT_PORT, TFT_CS_PIN)
#define TFT_CS_HIGH()       DL_GPIO_setPins(TFT_PORT, TFT_CS_PIN)
#define TFT_DC_LOW()        DL_GPIO_clearPins(TFT_PORT, TFT_DC_PIN)
#define TFT_DC_HIGH()       DL_GPIO_setPins(TFT_PORT, TFT_DC_PIN)
#define TFT_RES_LOW()       DL_GPIO_clearPins(TFT_PORT, TFT_RES_PIN)
#define TFT_RES_HIGH()      DL_GPIO_setPins(TFT_PORT, TFT_RES_PIN)
#define TFT_BLK_LOW()       DL_GPIO_clearPins(TFT_PORT, TFT_BLK_PIN)
#define TFT_BLK_HIGH()      DL_GPIO_setPins(TFT_PORT, TFT_BLK_PIN)

/* ================================================================
 *  ST7735 指令定义
 * ================================================================ */
#define ST7735_NOP          0x00
#define ST7735_SWRESET      0x01    /* 软件复位 */
#define ST7735_RDDID        0x04
#define ST7735_RDDST        0x09
#define ST7735_SLPIN        0x10    /* 进入睡眠 */
#define ST7735_SLPOUT       0x11    /* 退出睡眠 */
#define ST7735_PTLON        0x12
#define ST7735_NORON        0x13    /* 正常显示模式 */
#define ST7735_INVOFF       0x20    /* 关闭反转 */
#define ST7735_INVON        0x21    /* 开启反转 */
#define ST7735_DISPOFF      0x28    /* 关闭显示 */
#define ST7735_DISPON       0x29    /* 开启显示 */
#define ST7735_CASET        0x2A    /* 列地址设置 */
#define ST7735_RASET        0x2B    /* 行地址设置 */
#define ST7735_RAMWR        0x2C    /* 内存写入 */
#define ST7735_RAMRD        0x2E    /* 内存读取 */
#define ST7735_PTLAR        0x30
#define ST7735_COLMOD       0x3A    /* 色彩模式 */
#define ST7735_MADCTL       0x36    /* 内存访问控制（方向） */
#define ST7735_FRMCTR1      0xB1    /* 帧速率控制1 */
#define ST7735_FRMCTR2      0xB2
#define ST7735_FRMCTR3      0xB3
#define ST7735_INVCTR       0xB4    /* 反转控制 */
#define ST7735_DISSET5      0xB6
#define ST7735_PWCTR1       0xC0    /* 电源控制1 */
#define ST7735_PWCTR2       0xC1
#define ST7735_PWCTR3       0xC2
#define ST7735_PWCTR4       0xC3
#define ST7735_PWCTR5       0xC4
#define ST7735_VMCTR1       0xC5
#define ST7735_RDID1        0xDA
#define ST7735_RDID2        0xDB
#define ST7735_RDID3        0xDC
#define ST7735_RDID4        0xDD
#define ST7735_PWCTR6       0xFC
#define ST7735_GMCTRP1      0xE0    /* 正极性 Gamma 校正 */
#define ST7735_GMCTRN1      0xE1    /* 负极性 Gamma 校正 */

/* ================================================================
 *  屏幕方向控制（MADCTL 寄存器位）
 * ================================================================ */
#define MADCTL_MY           0x80
#define MADCTL_MX           0x40
#define MADCTL_MV           0x20
#define MADCTL_ML           0x10
#define MADCTL_RGB          0x00
#define MADCTL_BGR          0x08
#define MADCTL_MH           0x04

/* ================================================================
 *  1.8" 128x160 ST7735S 面板（中景园 ZJY180S0800TG01）
 *  横屏 (MV=1)：GM[1:0]="11" 模式下芯片自动映射，偏移为 0
 *  若实测仍有错位，微调（常见偏移 ±2 以内）
 * ================================================================ */
#define TFT_COL_OFFSET      0U
#define TFT_ROW_OFFSET      0U

/* ================================================================
 *  延时函数
 * ================================================================ */
static void delay_ms(volatile uint32_t ms)
{
    for (volatile uint32_t i = 0; i < ms; i++) {
        for (volatile uint32_t j = 0; j < 8000; j++) {
            __NOP();
        }
    }
}

/* ================================================================
 *  W25Q128 CS 控制（确保不与 TFT 同时选中）
 *  通过 ti_msp_dl_config.h 中的宏操作 PA15
 * ================================================================ */
static inline void FLASH_CS_HIGH(void)
{
    DL_GPIO_setPins(CS_PORT, CS_SPI1_CS_PIN);
}

static inline void FLASH_CS_LOW(void)
{
    DL_GPIO_clearPins(CS_PORT, CS_SPI1_CS_PIN);
}

/* ================================================================
 *  硬件 SPI1 字节发送（仅发送，不读 RX）
 *  与 port_flash.c 共享 SPI1，每次传输前确保 Flash CS 为高
 * ================================================================ */
static void spi_send_byte(uint8_t data)
{
    uint32_t timeout;

    /* 等待 TX FIFO 可写 */
    timeout = SPI_TIMEOUT_CNT;
    while (!DL_SPI_isTXFIFOEmpty(W25Q64_INST)) {
        if (--timeout == 0) break;
    }

    /* 发送字节 */
    DL_SPI_transmitDataBlocking8(W25Q64_INST, data);

    /* 等待接收完成并丢弃 RX 数据（TFT 不需要 MISO） */
    timeout = SPI_TIMEOUT_CNT;
    while (DL_SPI_isRXFIFOEmpty(W25Q64_INST)) {
        if (--timeout == 0) break;
    }
    (void)DL_SPI_receiveDataBlocking8(W25Q64_INST);
}

/* ================================================================
 *  ST7735 底层操作
 * ================================================================ */

static void tft_write_command(uint8_t cmd)
{
    FLASH_CS_HIGH();        /* 确保 Flash 不选中 */
    TFT_DC_LOW();           /* DC=0 → 命令模式 */
    TFT_CS_LOW();           /* 选中 TFT */
    spi_send_byte(cmd);
    TFT_CS_HIGH();          /* 释放 TFT */
}

static void tft_write_data(uint8_t data)
{
    FLASH_CS_HIGH();        /* 确保 Flash 不选中 */
    TFT_DC_HIGH();          /* DC=1 → 数据模式 */
    TFT_CS_LOW();           /* 选中 TFT */
    spi_send_byte(data);
    TFT_CS_HIGH();          /* 释放 TFT */
}

static void tft_write_data16(uint16_t data)
{
    FLASH_CS_HIGH();
    TFT_DC_HIGH();
    TFT_CS_LOW();
    spi_send_byte((uint8_t)(data >> 8));
    spi_send_byte((uint8_t)(data & 0xFF));
    TFT_CS_HIGH();
}

/**
 * @brief 设置屏幕窗口（列/行范围）
 * @note  ST7735 要求先设 CASET（列），再设 RASET（行），
 *        之后 RAMWR 写入的颜色数据将填充该窗口
 */
static void tft_set_window(uint16_t x1, uint16_t y1, uint16_t x2, uint16_t y2)
{
    tft_write_command(ST7735_CASET);
    tft_write_data16(x1 + TFT_COL_OFFSET);  /* 补偿面板列偏移 */
    tft_write_data16(x2 + TFT_COL_OFFSET);

    tft_write_command(ST7735_RASET);
    tft_write_data16(y1 + TFT_ROW_OFFSET);  /* 补偿面板行偏移 */
    tft_write_data16(y2 + TFT_ROW_OFFSET);

    tft_write_command(ST7735_RAMWR);
}

/* ================================================================
 *  GPIO 初始化
 *  用户反馈各引脚默认均为低电平，需在 init 中将工作电平纠正为：
 *    CS      → 高（空闲不选中，低有效）
 *    DC      → 保持低（命令模式）
 *    RESET   → 先低后高（低有效复位后恢复高）
 *    BLK     → 高（背光使能）
 * ================================================================ */
static void tft_gpio_init(void)
{
    /* CS (PB14) - 输出，初始高电平（不选中） */
    DL_GPIO_initDigitalOutput(LCD_LCD_CS_IOMUX);
    TFT_CS_HIGH();
    DL_GPIO_enableOutput(TFT_PORT, TFT_CS_PIN);

    /* DC (PB11) - 输出，初始低电平（命令模式） */
    DL_GPIO_initDigitalOutput(LCD_LCD_DC_IOMUX);
    TFT_DC_LOW();
    DL_GPIO_enableOutput(TFT_PORT, TFT_DC_PIN);

    /* RESET (PB10) - 输出，初始低电平（准备复位） */
    DL_GPIO_initDigitalOutput(LCD_LCD_RES_IOMUX);
    TFT_RES_LOW();
    DL_GPIO_enableOutput(TFT_PORT, TFT_RES_PIN);

    /* BLK (PB26) - 输出，初始高电平（点亮背光） */
    DL_GPIO_initDigitalOutput(LCD_LCD_BLK_IOMUX);
    TFT_BLK_HIGH();
    DL_GPIO_enableOutput(TFT_PORT, TFT_BLK_PIN);
}

/* ================================================================
 *  ST7735 硬件复位
 *  时序：低（保持≥10ms）→ 高 → 等待 120ms
 * ================================================================ */
static void tft_hardware_reset(void)
{
    TFT_RES_LOW();
    delay_ms(20);           /* 低电平保持 20ms（手册要求 ≥10ms） */
    TFT_RES_HIGH();
    delay_ms(120);          /* 复位后等待初始化完成 */
}

/* ================================================================
 *  ST7735S 初始化序列（标准初始化 + Gamma 校正）
 *  适配中景园 ZJY180S0800TG01 1.8 寸 128x160 模块（横屏 160x128）
 * ================================================================ */
static void tft_init_sequence(void)
{
    /* 1. 软件复位 */
    tft_write_command(ST7735_SWRESET);
    delay_ms(150);

    /* 2. 退出睡眠模式 */
    tft_write_command(ST7735_SLPOUT);
    delay_ms(120);

    /* 3. 帧速率控制（正常模式） */
    tft_write_command(ST7735_FRMCTR1);
    tft_write_data(0x01);       /* 最快帧率 */
    tft_write_data(0x2C);
    tft_write_data(0x2D);

    tft_write_command(ST7735_FRMCTR2);
    tft_write_data(0x01);
    tft_write_data(0x2C);
    tft_write_data(0x2D);

    tft_write_command(ST7735_FRMCTR3);
    tft_write_data(0x01);
    tft_write_data(0x2C);
    tft_write_data(0x2D);
    tft_write_data(0x01);
    tft_write_data(0x2C);
    tft_write_data(0x2D);

    /* 4. 反转控制 */
    tft_write_command(ST7735_INVCTR);
    tft_write_data(0x07);

    /* 5. 电源控制 */
    tft_write_command(ST7735_PWCTR1);
    tft_write_data(0xA2);
    tft_write_data(0x02);
    tft_write_data(0x84);

    tft_write_command(ST7735_PWCTR2);
    tft_write_data(0xC5);

    tft_write_command(ST7735_PWCTR3);
    tft_write_data(0x0A);
    tft_write_data(0x00);

    tft_write_command(ST7735_PWCTR4);
    tft_write_data(0x8A);
    tft_write_data(0x2A);

    tft_write_command(ST7735_PWCTR5);
    tft_write_data(0x8A);
    tft_write_data(0xEE);

    tft_write_command(ST7735_VMCTR1);
    tft_write_data(0x0E);

    /* 6. 开启反转（0.96" 红板需 INVON，否则黑白反相显示为白底黑字） */
    tft_write_command(ST7735_INVON);

    /* 7. 内存访问控制：横屏（MY=0, MX=1, MV=1, ML=0, RGB）, 左下角原点 */
    tft_write_command(ST7735_MADCTL);
    tft_write_data(MADCTL_MX | MADCTL_MV | MADCTL_RGB);

    /* 8. 色彩模式：16位（RGB565） */
    tft_write_command(ST7735_COLMOD);
    tft_write_data(0x05);       /* 16-bit/pixel */

    /* 9. 列/行地址设置为 160x128 全屏（MV=1 时 X/Y 交换，含面板偏移） */
    tft_write_command(ST7735_CASET);
    tft_write_data16(TFT_COL_OFFSET);
    tft_write_data16(TFT_COL_OFFSET + TFT_WIDTH - 1);    /* 160 列 (0-159) + 偏移 */

    tft_write_command(ST7735_RASET);
    tft_write_data16(TFT_ROW_OFFSET);
    tft_write_data16(TFT_ROW_OFFSET + TFT_HEIGHT - 1);   /* 128 行 (0-127) + 偏移 */

    /* 10. Gamma 校正（正极性） */
    tft_write_command(ST7735_GMCTRP1);
    tft_write_data(0x02);
    tft_write_data(0x1C);
    tft_write_data(0x07);
    tft_write_data(0x12);
    tft_write_data(0x37);
    tft_write_data(0x32);
    tft_write_data(0x29);
    tft_write_data(0x2D);
    tft_write_data(0x29);
    tft_write_data(0x25);
    tft_write_data(0x2B);
    tft_write_data(0x39);
    tft_write_data(0x00);
    tft_write_data(0x01);
    tft_write_data(0x03);
    tft_write_data(0x10);

    /* 11. Gamma 校正（负极性） */
    tft_write_command(ST7735_GMCTRN1);
    tft_write_data(0x03);
    tft_write_data(0x1D);
    tft_write_data(0x07);
    tft_write_data(0x06);
    tft_write_data(0x2E);
    tft_write_data(0x2C);
    tft_write_data(0x29);
    tft_write_data(0x2D);
    tft_write_data(0x2E);
    tft_write_data(0x2E);
    tft_write_data(0x37);
    tft_write_data(0x3F);
    tft_write_data(0x00);
    tft_write_data(0x00);
    tft_write_data(0x02);
    tft_write_data(0x10);

    /* 12. 正常显示模式 */
    tft_write_command(ST7735_NORON);
    delay_ms(10);

    /* 13. 开启显示 */
    tft_write_command(ST7735_DISPON);
    delay_ms(10);
}

/* ================================================================
 *  ASCII 8×16 字库（空格 0x20 ~ 波浪线 0x7E，共 95 个字符）
 *  每个字符 16 字节，纵向扫描 MSB-first
 * ================================================================ */
static const uint8_t font_8x16[95][16] = {
    /* ' ' (0x20) */
    {0x00,0x00,0x00,0x00,0x00,0x00,0x00,0x00,
     0x00,0x00,0x00,0x00,0x00,0x00,0x00,0x00},
    /* '!' */
    {0x00,0x00,0x00,0x18,0x3C,0x3C,0x3C,0x18,
     0x18,0x18,0x00,0x18,0x18,0x00,0x00,0x00},
    /* '"' */
    {0x00,0x00,0x66,0x66,0x66,0x24,0x00,0x00,
     0x00,0x00,0x00,0x00,0x00,0x00,0x00,0x00},
    /* '#' */
    {0x00,0x00,0x00,0x6C,0x6C,0xFE,0x6C,0x6C,
     0x6C,0xFE,0x6C,0x6C,0x00,0x00,0x00,0x00},
    /* '$' */
    {0x18,0x18,0x7C,0xC6,0xC2,0xC0,0x7C,0x06,
     0x86,0xC6,0x7C,0x18,0x18,0x00,0x00,0x00},
    /* '%' */
    {0x00,0x00,0x00,0x00,0xC2,0xC6,0x0C,0x18,
     0x30,0x60,0xC6,0x86,0x00,0x00,0x00,0x00},
    /* '&' */
    {0x00,0x00,0x38,0x6C,0x6C,0x38,0x76,0xDC,
     0xCC,0xCC,0xCC,0x76,0x00,0x00,0x00,0x00},
    /* ''' */
    {0x00,0x30,0x30,0x30,0x60,0x00,0x00,0x00,
     0x00,0x00,0x00,0x00,0x00,0x00,0x00,0x00},
    /* '(' */
    {0x00,0x00,0x0C,0x18,0x30,0x30,0x30,0x30,
     0x30,0x30,0x18,0x0C,0x00,0x00,0x00,0x00},
    /* ')' */
    {0x00,0x00,0x30,0x18,0x0C,0x0C,0x0C,0x0C,
     0x0C,0x0C,0x18,0x30,0x00,0x00,0x00,0x00},
    /* '*' */
    {0x00,0x00,0x00,0x00,0x00,0x66,0x3C,0xFF,
     0x3C,0x66,0x00,0x00,0x00,0x00,0x00,0x00},
    /* '+' */
    {0x00,0x00,0x00,0x00,0x00,0x18,0x18,0x7E,
     0x18,0x18,0x00,0x00,0x00,0x00,0x00,0x00},
    /* ',' */
    {0x00,0x00,0x00,0x00,0x00,0x00,0x00,0x00,
     0x00,0x18,0x18,0x18,0x30,0x00,0x00,0x00},
    /* '-' */
    {0x00,0x00,0x00,0x00,0x00,0x00,0x00,0x7E,
     0x00,0x00,0x00,0x00,0x00,0x00,0x00,0x00},
    /* '.' */
    {0x00,0x00,0x00,0x00,0x00,0x00,0x00,0x00,
     0x00,0x00,0x18,0x18,0x00,0x00,0x00,0x00},
    /* '/' */
    {0x00,0x00,0x00,0x00,0x02,0x06,0x0C,0x18,
     0x30,0x60,0xC0,0x80,0x00,0x00,0x00,0x00},
    /* '0' */
    {0x00,0x00,0x38,0x6C,0xC6,0xC6,0xD6,0xD6,
     0xC6,0xC6,0x6C,0x38,0x00,0x00,0x00,0x00},
    /* '1' */
    {0x00,0x00,0x18,0x38,0x78,0x18,0x18,0x18,
     0x18,0x18,0x18,0x7E,0x00,0x00,0x00,0x00},
    /* '2' */
    {0x00,0x00,0x7C,0xC6,0x06,0x0C,0x18,0x30,
     0x60,0xC0,0xC6,0xFE,0x00,0x00,0x00,0x00},
    /* '3' */
    {0x00,0x00,0x7C,0xC6,0x06,0x06,0x3C,0x06,
     0x06,0x06,0xC6,0x7C,0x00,0x00,0x00,0x00},
    /* '4' */
    {0x00,0x00,0x0C,0x1C,0x3C,0x6C,0xCC,0xFE,
     0x0C,0x0C,0x0C,0x1E,0x00,0x00,0x00,0x00},
    /* '5' */
    {0x00,0x00,0xFE,0xC0,0xC0,0xC0,0xFC,0x06,
     0x06,0x06,0xC6,0x7C,0x00,0x00,0x00,0x00},
    /* '6' */
    {0x00,0x00,0x38,0x60,0xC0,0xC0,0xFC,0xC6,
     0xC6,0xC6,0xC6,0x7C,0x00,0x00,0x00,0x00},
    /* '7' */
    {0x00,0x00,0xFE,0xC6,0x06,0x06,0x0C,0x18,
     0x30,0x30,0x30,0x30,0x00,0x00,0x00,0x00},
    /* '8' */
    {0x00,0x00,0x7C,0xC6,0xC6,0xC6,0x7C,0xC6,
     0xC6,0xC6,0xC6,0x7C,0x00,0x00,0x00,0x00},
    /* '9' */
    {0x00,0x00,0x7C,0xC6,0xC6,0xC6,0x7E,0x06,
     0x06,0x06,0x0C,0x78,0x00,0x00,0x00,0x00},
    /* ':' */
    {0x00,0x00,0x00,0x00,0x18,0x18,0x00,0x00,
     0x00,0x18,0x18,0x00,0x00,0x00,0x00,0x00},
    /* ';' */
    {0x00,0x00,0x00,0x00,0x18,0x18,0x00,0x00,
     0x00,0x18,0x18,0x30,0x00,0x00,0x00,0x00},
    /* '<' */
    {0x00,0x00,0x00,0x06,0x0C,0x18,0x30,0x60,
     0x30,0x18,0x0C,0x06,0x00,0x00,0x00,0x00},
    /* '=' */
    {0x00,0x00,0x00,0x00,0x00,0x7E,0x00,0x00,
     0x7E,0x00,0x00,0x00,0x00,0x00,0x00,0x00},
    /* '>' */
    {0x00,0x00,0x00,0x60,0x30,0x18,0x0C,0x06,
     0x0C,0x18,0x30,0x60,0x00,0x00,0x00,0x00},
    /* '?' */
    {0x00,0x00,0x7C,0xC6,0xC6,0x0C,0x18,0x18,
     0x18,0x00,0x18,0x18,0x00,0x00,0x00,0x00},
    /* '@' */
    {0x00,0x00,0x00,0x7C,0xC6,0xC6,0xDE,0xDE,
     0xDE,0xDC,0xC0,0x7C,0x00,0x00,0x00,0x00},
    /* 'A' */
    {0x00,0x00,0x10,0x38,0x6C,0xC6,0xC6,0xFE,
     0xC6,0xC6,0xC6,0xC6,0x00,0x00,0x00,0x00},
    /* 'B' */
    {0x00,0x00,0xFC,0x66,0x66,0x66,0x7C,0x66,
     0x66,0x66,0x66,0xFC,0x00,0x00,0x00,0x00},
    /* 'C' */
    {0x00,0x00,0x3C,0x66,0xC2,0xC0,0xC0,0xC0,
     0xC0,0xC2,0x66,0x3C,0x00,0x00,0x00,0x00},
    /* 'D' */
    {0x00,0x00,0xF8,0x6C,0x66,0x66,0x66,0x66,
     0x66,0x66,0x6C,0xF8,0x00,0x00,0x00,0x00},
    /* 'E' */
    {0x00,0x00,0xFE,0x66,0x62,0x68,0x78,0x68,
     0x60,0x62,0x66,0xFE,0x00,0x00,0x00,0x00},
    /* 'F' */
    {0x00,0x00,0xFE,0x66,0x62,0x68,0x78,0x68,
     0x60,0x60,0x60,0xF0,0x00,0x00,0x00,0x00},
    /* 'G' */
    {0x00,0x00,0x3C,0x66,0xC2,0xC0,0xC0,0xDE,
     0xC6,0xC6,0x66,0x3A,0x00,0x00,0x00,0x00},
    /* 'H' */
    {0x00,0x00,0xC6,0xC6,0xC6,0xC6,0xFE,0xC6,
     0xC6,0xC6,0xC6,0xC6,0x00,0x00,0x00,0x00},
    /* 'I' */
    {0x00,0x00,0x3C,0x18,0x18,0x18,0x18,0x18,
     0x18,0x18,0x18,0x3C,0x00,0x00,0x00,0x00},
    /* 'J' */
    {0x00,0x00,0x1E,0x0C,0x0C,0x0C,0x0C,0x0C,
     0xCC,0xCC,0xCC,0x78,0x00,0x00,0x00,0x00},
    /* 'K' */
    {0x00,0x00,0xE6,0x66,0x66,0x6C,0x78,0x78,
     0x6C,0x66,0x66,0xE6,0x00,0x00,0x00,0x00},
    /* 'L' */
    {0x00,0x00,0xF0,0x60,0x60,0x60,0x60,0x60,
     0x60,0x62,0x66,0xFE,0x00,0x00,0x00,0x00},
    /* 'M' */
    {0x00,0x00,0xC6,0xEE,0xFE,0xFE,0xD6,0xC6,
     0xC6,0xC6,0xC6,0xC6,0x00,0x00,0x00,0x00},
    /* 'N' */
    {0x00,0x00,0xC6,0xE6,0xF6,0xFE,0xDE,0xCE,
     0xC6,0xC6,0xC6,0xC6,0x00,0x00,0x00,0x00},
    /* 'O' */
    {0x00,0x00,0x38,0x6C,0xC6,0xC6,0xC6,0xC6,
     0xC6,0xC6,0x6C,0x38,0x00,0x00,0x00,0x00},
    /* 'P' */
    {0x00,0x00,0xFC,0x66,0x66,0x66,0x7C,0x60,
     0x60,0x60,0x60,0xF0,0x00,0x00,0x00,0x00},
    /* 'Q' */
    {0x00,0x00,0x38,0x6C,0xC6,0xC6,0xC6,0xC6,
     0xC6,0xCE,0x7C,0x06,0x0E,0x00,0x00,0x00},
    /* 'R' */
    {0x00,0x00,0xFC,0x66,0x66,0x66,0x7C,0x6C,
     0x66,0x66,0x66,0xE6,0x00,0x00,0x00,0x00},
    /* 'S' */
    {0x00,0x00,0x7C,0xC6,0xC6,0x60,0x38,0x0C,
     0x06,0xC6,0xC6,0x7C,0x00,0x00,0x00,0x00},
    /* 'T' */
    {0x00,0x00,0x7E,0x7E,0x5A,0x18,0x18,0x18,
     0x18,0x18,0x18,0x3C,0x00,0x00,0x00,0x00},
    /* 'U' */
    {0x00,0x00,0xC6,0xC6,0xC6,0xC6,0xC6,0xC6,
     0xC6,0xC6,0xC6,0x7C,0x00,0x00,0x00,0x00},
    /* 'V' */
    {0x00,0x00,0xC6,0xC6,0xC6,0xC6,0xC6,0xC6,
     0xC6,0x6C,0x38,0x10,0x00,0x00,0x00,0x00},
    /* 'W' */
    {0x00,0x00,0xC6,0xC6,0xC6,0xC6,0xD6,0xD6,
     0xD6,0xFE,0xEE,0x6C,0x00,0x00,0x00,0x00},
    /* 'X' */
    {0x00,0x00,0xC6,0xC6,0x6C,0x7C,0x38,0x38,
     0x7C,0x6C,0xC6,0xC6,0x00,0x00,0x00,0x00},
    /* 'Y' */
    {0x00,0x00,0x66,0x66,0x66,0x66,0x3C,0x18,
     0x18,0x18,0x18,0x3C,0x00,0x00,0x00,0x00},
    /* 'Z' */
    {0x00,0x00,0xFE,0xC6,0x86,0x0C,0x18,0x30,
     0x60,0xC2,0xC6,0xFE,0x00,0x00,0x00,0x00},
    /* '[' */
    {0x00,0x00,0x3C,0x30,0x30,0x30,0x30,0x30,
     0x30,0x30,0x30,0x3C,0x00,0x00,0x00,0x00},
    /* '\' */
    {0x00,0x00,0x00,0x80,0xC0,0xE0,0x70,0x38,
     0x1C,0x0E,0x06,0x02,0x00,0x00,0x00,0x00},
    /* ']' */
    {0x00,0x00,0x3C,0x0C,0x0C,0x0C,0x0C,0x0C,
     0x0C,0x0C,0x0C,0x3C,0x00,0x00,0x00,0x00},
    /* '^' */
    {0x10,0x38,0x6C,0xC6,0x00,0x00,0x00,0x00,
     0x00,0x00,0x00,0x00,0x00,0x00,0x00,0x00},
    /* '_' */
    {0x00,0x00,0x00,0x00,0x00,0x00,0x00,0x00,
     0x00,0x00,0x00,0x00,0x00,0xFF,0x00,0x00},
    /* '`' */
    {0x18,0x18,0x18,0x0C,0x00,0x00,0x00,0x00,
     0x00,0x00,0x00,0x00,0x00,0x00,0x00,0x00},
    /* 'a' */
    {0x00,0x00,0x00,0x00,0x00,0x78,0x0C,0x7C,
     0xCC,0xCC,0xCC,0x76,0x00,0x00,0x00,0x00},
    /* 'b' */
    {0x00,0x00,0xE0,0x60,0x60,0x78,0x6C,0x66,
     0x66,0x66,0x66,0x7C,0x00,0x00,0x00,0x00},
    /* 'c' */
    {0x00,0x00,0x00,0x00,0x00,0x7C,0xC6,0xC0,
     0xC0,0xC0,0xC6,0x7C,0x00,0x00,0x00,0x00},
    /* 'd' */
    {0x00,0x00,0x1C,0x0C,0x0C,0x3C,0x6C,0xCC,
     0xCC,0xCC,0xCC,0x76,0x00,0x00,0x00,0x00},
    /* 'e' */
    {0x00,0x00,0x00,0x00,0x00,0x7C,0xC6,0xFE,
     0xC0,0xC0,0xC6,0x7C,0x00,0x00,0x00,0x00},
    /* 'f' */
    {0x00,0x00,0x1C,0x36,0x32,0x30,0x78,0x30,
     0x30,0x30,0x30,0x78,0x00,0x00,0x00,0x00},
    /* 'g' */
    {0x00,0x00,0x00,0x00,0x00,0x76,0xCC,0xCC,
     0xCC,0xCC,0xCC,0x7C,0x0C,0xCC,0x78,0x00},
    /* 'h' */
    {0x00,0x00,0xE0,0x60,0x60,0x6C,0x76,0x66,
     0x66,0x66,0x66,0xE6,0x00,0x00,0x00,0x00},
    /* 'i' */
    {0x00,0x00,0x18,0x18,0x00,0x38,0x18,0x18,
     0x18,0x18,0x18,0x3C,0x00,0x00,0x00,0x00},
    /* 'j' */
    {0x00,0x00,0x06,0x06,0x00,0x0E,0x06,0x06,
     0x06,0x06,0x06,0x06,0x66,0x66,0x3C,0x00},
    /* 'k' */
    {0x00,0x00,0xE0,0x60,0x60,0x66,0x6C,0x78,
     0x78,0x6C,0x66,0xE6,0x00,0x00,0x00,0x00},
    /* 'l' */
    {0x00,0x00,0x38,0x18,0x18,0x18,0x18,0x18,
     0x18,0x18,0x18,0x3C,0x00,0x00,0x00,0x00},
    /* 'm' */
    {0x00,0x00,0x00,0x00,0x00,0xEC,0xFE,0xD6,
     0xD6,0xD6,0xD6,0xC6,0x00,0x00,0x00,0x00},
    /* 'n' */
    {0x00,0x00,0x00,0x00,0x00,0xDC,0x66,0x66,
     0x66,0x66,0x66,0x66,0x00,0x00,0x00,0x00},
    /* 'o' */
    {0x00,0x00,0x00,0x00,0x00,0x7C,0xC6,0xC6,
     0xC6,0xC6,0xC6,0x7C,0x00,0x00,0x00,0x00},
    /* 'p' */
    {0x00,0x00,0x00,0x00,0x00,0xDC,0x66,0x66,
     0x66,0x66,0x66,0x7C,0x60,0x60,0xF0,0x00},
    /* 'q' */
    {0x00,0x00,0x00,0x00,0x00,0x76,0xCC,0xCC,
     0xCC,0xCC,0xCC,0x7C,0x0C,0x0C,0x1E,0x00},
    /* 'r' */
    {0x00,0x00,0x00,0x00,0x00,0xDC,0x76,0x66,
     0x60,0x60,0x60,0xF0,0x00,0x00,0x00,0x00},
    /* 's' */
    {0x00,0x00,0x00,0x00,0x00,0x7C,0xC6,0x60,
     0x38,0x0C,0xC6,0x7C,0x00,0x00,0x00,0x00},
    /* 't' */
    {0x00,0x00,0x10,0x30,0x30,0xFC,0x30,0x30,
     0x30,0x30,0x36,0x1C,0x00,0x00,0x00,0x00},
    /* 'u' */
    {0x00,0x00,0x00,0x00,0x00,0xCC,0xCC,0xCC,
     0xCC,0xCC,0xCC,0x76,0x00,0x00,0x00,0x00},
    /* 'v' */
    {0x00,0x00,0x00,0x00,0x00,0xC6,0xC6,0xC6,
     0xC6,0xC6,0x6C,0x38,0x00,0x00,0x00,0x00},
    /* 'w' */
    {0x00,0x00,0x00,0x00,0x00,0xC6,0xC6,0xD6,
     0xD6,0xD6,0xFE,0x6C,0x00,0x00,0x00,0x00},
    /* 'x' */
    {0x00,0x00,0x00,0x00,0x00,0xC6,0x6C,0x38,
     0x38,0x38,0x6C,0xC6,0x00,0x00,0x00,0x00},
    /* 'y' */
    {0x00,0x00,0x00,0x00,0x00,0xC6,0xC6,0xC6,
     0xC6,0xC6,0xC6,0x7E,0x06,0x0C,0xF8,0x00},
    /* 'z' */
    {0x00,0x00,0x00,0x00,0x00,0xFE,0xCC,0x18,
     0x30,0x60,0xC6,0xFE,0x00,0x00,0x00,0x00},
    /* '{' */
    {0x00,0x00,0x0E,0x18,0x18,0x18,0x70,0x18,
     0x18,0x18,0x18,0x0E,0x00,0x00,0x00,0x00},
    /* '|' */
    {0x00,0x00,0x18,0x18,0x18,0x18,0x00,0x18,
     0x18,0x18,0x18,0x18,0x00,0x00,0x00,0x00},
    /* '}' */
    {0x00,0x00,0x70,0x18,0x18,0x18,0x0E,0x18,
     0x18,0x18,0x18,0x70,0x00,0x00,0x00,0x00},
    /* '~' */
    {0x00,0x00,0x76,0xDC,0x00,0x00,0x00,0x00,
     0x00,0x00,0x00,0x00,0x00,0x00,0x00,0x00}
};

/* ================================================================
 *  光标状态（用于类似 print 的流式输出）
 * ================================================================ */
static uint16_t g_cursorX = 0;
static uint16_t g_cursorY = 0;
#define CHAR_WIDTH      8
#define CHAR_HEIGHT     16

/* 前向声明 */
static void tft_fillScreen(DevTFT *self, uint16_t color);

/* ================================================================
 *  DevTFT 接口函数实现
 * ================================================================ */

/**
 * @brief TFT 初始化：GPIO 配置 → 硬件复位 → SPI1 初始化 → 初始化序列
 */
static void tft_init(DevTFT *self)
{
    (void)self;

    /* 1. 初始化 GPIO 并纠正电平 */
    tft_gpio_init();

    /* 2. 硬件复位 */
    tft_hardware_reset();

    /* 3. 初始化 SPI1（与 W25Q128 共用，SysConfig 已配置） */
    SYSCFG_DL_W25Q64_init();

    /* 4. 发送初始化序列 */
    tft_init_sequence();

    /* 5. 清屏为黑色 */
    tft_fillScreen(self, TFT_BLACK);

    /* 6. 初始化光标 */
    g_cursorX = 0;
    g_cursorY = 0;
}

/**
 * @brief 填充整个屏幕为指定颜色
 */
static void tft_fillScreen(DevTFT *self, uint16_t color)
{
    uint16_t x, y;

    (void)self;

    tft_set_window(0, 0, TFT_WIDTH - 1, TFT_HEIGHT - 1);

    FLASH_CS_HIGH();
    TFT_DC_HIGH();
    TFT_CS_LOW();

    for (y = 0; y < TFT_HEIGHT; y++) {
        for (x = 0; x < TFT_WIDTH; x++) {
            spi_send_byte((uint8_t)(color >> 8));
            spi_send_byte((uint8_t)(color & 0xFF));
        }
    }

    TFT_CS_HIGH();
}

/**
 * @brief 画单个像素点
 */
static void tft_drawPixel(DevTFT *self, uint16_t x, uint16_t y, uint16_t color)
{
    (void)self;

    if (x >= TFT_WIDTH || y >= TFT_HEIGHT) return;

    tft_set_window(x, y, x, y);

    FLASH_CS_HIGH();
    TFT_DC_HIGH();
    TFT_CS_LOW();
    spi_send_byte((uint8_t)(color >> 8));
    spi_send_byte((uint8_t)(color & 0xFF));
    TFT_CS_HIGH();
}

/**
 * @brief 填充矩形区域
 */
static void tft_fillRect(DevTFT *self, uint16_t x, uint16_t y,
                         uint16_t w, uint16_t h, uint16_t color)
{
    uint16_t ex, ey;
    uint32_t pixelCount;

    (void)self;

    if (x >= TFT_WIDTH || y >= TFT_HEIGHT) return;

    ex = (x + w - 1 < TFT_WIDTH) ? (x + w - 1) : (TFT_WIDTH - 1);
    ey = (y + h - 1 < TFT_HEIGHT) ? (y + h - 1) : (TFT_HEIGHT - 1);

    pixelCount = (uint32_t)(ex - x + 1) * (ey - y + 1);

    tft_set_window(x, y, ex, ey);

    FLASH_CS_HIGH();
    TFT_DC_HIGH();
    TFT_CS_LOW();

    while (pixelCount--) {
        spi_send_byte((uint8_t)(color >> 8));
        spi_send_byte((uint8_t)(color & 0xFF));
    }

    TFT_CS_HIGH();
}

/**
 * @brief 在指定坐标画一个 ASCII 字符（8×16 字体）
 * @param x     起始 X 坐标
 * @param y     起始 Y 坐标
 * @param ch    ASCII 字符
 * @param color 前景色 (RGB565)
 * @param bg    背景色 (RGB565)
 */
static void tft_drawChar(DevTFT *self, uint16_t x, uint16_t y, char ch,
                         uint16_t color, uint16_t bg)
{
    uint8_t col, row;
    uint8_t idx;

    (void)self;

    if (ch < 0x20 || ch > 0x7E) ch = ' ';

    idx = (uint8_t)(ch - 0x20);

    for (row = 0; row < CHAR_HEIGHT; row++) {
        uint8_t line = font_8x16[idx][row];

        for (col = 0; col < CHAR_WIDTH; col++) {
            if (line & (0x80 >> col)) {
                tft_drawPixel(self, x + col, y + row, color);
            } else {
                tft_drawPixel(self, x + col, y + row, bg);
            }
        }
    }
}

/**
 * @brief 在指定坐标显示字符串（手动指定位置）
 */
static void tft_printString(DevTFT *self, uint16_t x, uint16_t y,
                            const char *str, uint16_t color, uint16_t bg)
{
    uint16_t cx = x;

    (void)self;

    if (str == NULL) return;

    while (*str) {
        if (*str == '\n') {
            cx = x;
            y += CHAR_HEIGHT;
        } else if (*str == '\r') {
            cx = x;
        } else {
            tft_drawChar(self, cx, y, *str, color, bg);
            cx += CHAR_WIDTH;
            if (cx + CHAR_WIDTH > TFT_WIDTH) {
                cx = 0;
                y += CHAR_HEIGHT;
            }
        }

        if (y + CHAR_HEIGHT > TFT_HEIGHT) {
            y = 0;              /* 溢出后滚回顶部 */
        }

        str++;
    }
}

/**
 * @brief printf 风格格式化输出到指定坐标
 * @note  内部用 vsnprintf 格式化到栈缓冲后调用 tft_printString
 */
static void tft_printf(DevTFT *self, uint16_t x, uint16_t y,
                       uint16_t color, uint16_t bg, const char *fmt, ...)
{
    char buf[48];
    va_list ap;

    if (fmt == NULL) return;

    va_start(ap, fmt);
    vsnprintf(buf, sizeof(buf), fmt, ap);
    va_end(ap);

    tft_printString(self, x, y, buf, color, bg);
}

/**
 * @brief 设置光标位置（用于流式 print 输出）
 */
static void tft_setCursor(DevTFT *self, uint16_t x, uint16_t y)
{
    (void)self;
    g_cursorX = x;
    g_cursorY = y;
}

/**
 * @brief 在光标位置流式输出字符串（自动换行/换行）
 */
static void tft_print(DevTFT *self, const char *str, uint16_t color, uint16_t bg)
{
    (void)self;

    if (str == NULL) return;

    while (*str) {
        if (*str == '\n') {
            g_cursorX = 0;
            g_cursorY += CHAR_HEIGHT;
        } else if (*str == '\r') {
            g_cursorX = 0;
        } else {
            tft_drawChar(self, g_cursorX, g_cursorY, *str, color, bg);
            g_cursorX += CHAR_WIDTH;
            if (g_cursorX + CHAR_WIDTH > TFT_WIDTH) {
                g_cursorX = 0;
                g_cursorY += CHAR_HEIGHT;
            }
        }

        if (g_cursorY + CHAR_HEIGHT > TFT_HEIGHT) {
            g_cursorY = 0;      /* 溢出后滚回顶部 */
        }

        str++;
    }
}

/* ================================================================
 *  注册 Device 接口
 * ================================================================ */

DevTFT* GetTFT(void)
{
    s_tftIf.init         = tft_init;
    s_tftIf.fillScreen   = tft_fillScreen;
    s_tftIf.drawPixel    = tft_drawPixel;
    s_tftIf.drawChar     = tft_drawChar;
    s_tftIf.printString  = tft_printString;
    s_tftIf.setCursor    = tft_setCursor;
    s_tftIf.print        = tft_print;
    s_tftIf.fillRect     = tft_fillRect;
    s_tftIf.printf       = tft_printf;

    return &s_tftIf;
}